// SPDX-License-Identifier: GPL-2.0
// Copyright (c) 2018, Linaro Limited

/dts-v1/;

#include "qcs404-evb.dtsi"

/ {
	model = "Qualcomm Technologies, Inc. QCS404 EVB 1000";
	compatible = "qcom,qcs404-evb";
};

&blsp1_dma {
	qcom,controlled-remotely = <1>;
};

&blsp2_dma {
	qcom,controlled-remotely = <1>;
};

## Documentation/devicetree/bindings/power/avs/qcom,cpr.txt
```
QCOM CPR (Core Power Reduction)

CPR (Core Power Reduction) is a technology to reduce core power on a CPU
or other device. Each OPP of a device corresponds to a "corner" that has
a range of valid voltages for a particular frequency. While the device is
running at a particular frequency, CPR monitors dynamic factors such as
temperature, etc. and suggests adjustments to the voltage to save power
and meet silicon characteristic requirements.

- compatible:
	Usage: required
	Value type: <string>
	Definition: should be "qcom,qcs404-cpr", "qcom,cpr" for qcs404

- reg:
	Usage: required
	Value type: <prop-encoded-array>
	Definition: base address and size of the rbcpr register region

- interrupts:
	Usage: required
	Value type: <prop-encoded-array>
	Definition: should specify the CPR interrupt

- clocks:
	Usage: required
	Value type: <prop-encoded-array>
	Definition: phandle to the reference clock

- clock-names:
	Usage: required
	Value type: <stringlist>
	Definition: must be "ref"

- vdd-apc-supply:
	Usage: required
	Value type: <phandle>
	Definition: phandle to the vdd-apc-supply regulator

- #power-domain-cells:
	Usage: required
	Value type: <u32>
	Definition: should be 0

- operating-points-v2:
	Usage: required
	Value type: <phandle>
	Definition: A phandle to the OPP table containing the
		    performance states supported by the CPR
		    power domain

- acc-syscon:
	Usage: optional
	Value type: <phandle>
	Definition: phandle to syscon for writing ACC settings

- nvmem-cells:
	Usage: required
	Value type: <phandle>
	Definition: phandle to nvmem cells containing the data
		    that makes up a fuse corner, for each fuse corner.
		    As well as the CPR fuse revision.

- nvmem-cell-names:
	Usage: required
	Value type: <stringlist>
	Definition: should be "cpr_quotient_offset1", "cpr_quotient_offset2",
		    "cpr_quotient_offset3", "cpr_init_voltage1",
		    "cpr_init_voltage2", "cpr_init_voltage3", "cpr_quotient1",
		    "cpr_quotient2", "cpr_quotient3", "cpr_ring_osc1",
		    "cpr_ring_osc2", "cpr_ring_osc3", "cpr_fuse_revision"
		    for qcs404.

- qcom,cpr-timer-delay-us:
	Usage: required
	Value type: <u32>
	Definition: delay in uS for the timer interval

- qcom,cpr-timer-cons-up:
	Usage: required
	Value type: <u32>
	Definition: Consecutive number of timer intervals, or units of
		    qcom,cpr-timer-delay-us, that occur before issuing an up
		    interrupt

- qcom,cpr-timer-cons-down:
	Usage: required
	Value type: <u32>
	Definition: Consecutive number of timer intervals, or units of
		    qcom,cpr-timer-delay-us, that occur before issuing a down
		    interrupt

- qcom,cpr-up-threshold:
	Usage: optional
	Value type: <u32>
	Definition: The threshold for CPR to issue interrupt when error_steps
		    is greater than it when stepping up

- qcom,cpr-down-threshold:
	Usage: optional
	Value type: <u32>
	Definition: The threshold for CPR to issue interrupt when error_steps
		    is greater than it when stepping down

- qcom,cpr-idle-clocks:
	Usage: optional
	Value type: <u32>
	Definition: Idle clock cycles ring oscillator can be in

- qcom,cpr-gcnt-us:
	Usage: required
	Value type: <u32>
	Definition: The time for gate count in uS

- qcom,vdd-apc-step-up-limit:
	Usage: required
	Value type: <u32>
	Definition: Limit of number of vdd-apc-supply regulator steps for
		    scaling up

- qcom,vdd-apc-step-down-limit:
	Usage: required
	Value type: <u32>
	Definition: Limit of number of vdd-apc-supply regulator steps for
		    scaling down

Example:

	cpr_opp_table: cpr-opp-table {
		compatible = "operating-points-v2-qcom-level";

		cpr_opp1: opp1 {
			opp-level = <1>;
			....
		};
		cpr_opp2: opp2 {
			opp-level = <2>;
			....
		};
		cpr_opp3: opp3 {
			opp-level = <3>;
			....
		};
	};

	cpr@b018000 {
		compatible = "qcom,qcs404-cpr", "qcom,cpr";
		reg = <0x0b018000 0x1000>;
		interrupts = <0 15 IRQ_TYPE_EDGE_RISING>;
		clocks = <&xo_board>;
		clock-names = "ref";
		vdd-apc-supply = <&pms405_s3>;
		#power-domain-cells = <0>;
		operating-points-v2 = <&cpr_opp_table>;
		acc-syscon = <&tcsr>;

		nvmem-cells = <&cpr_efuse_quot_offset1>,
			<&cpr_efuse_quot_offset2>,
			<&cpr_efuse_quot_offset3>,
			<&cpr_efuse_init_voltage1>,
			<&cpr_efuse_init_voltage2>,
			<&cpr_efuse_init_voltage3>,
			<&cpr_efuse_quot1>,
			<&cpr_efuse_quot2>,
			<&cpr_efuse_quot3>,
			<&cpr_efuse_ring1>,
			<&cpr_efuse_ring2>,
			<&cpr_efuse_ring3>,
			<&cpr_efuse_revision>;
		nvmem-cell-names = "cpr_quotient_offset1",
			"cpr_quotient_offset2",
			"cpr_quotient_offset3",
			"cpr_init_voltage1",
			"cpr_init_voltage2",
			"cpr_init_voltage3",
			"cpr_quotient1",
			"cpr_quotient2",
			"cpr_quotient3",
			"cpr_ring_osc1",
			"cpr_ring_osc2",
			"cpr_ring_osc3",
			"cpr_fuse_revision";

		qcom,cpr-timer-delay-us = <5000>;
		qcom,cpr-timer-cons-up = <0>;
		qcom,cpr-timer-cons-down = <2>;
		qcom,cpr-up-threshold = <1>;
		qcom,cpr-down-threshold = <3>;
		qcom,cpr-idle-clocks = <15>;
		qcom,cpr-gcnt-us = <1>;
		qcom,vdd-apc-step-up-limit = <1>;
		qcom,vdd-apc-step-down-limit = <1>;
	};
```

## Documentation/devicetree/bindings/soc/qcom/qcom,ipa.txt
```
Qualcomm IPA (IP Accelerator) Driver

This binding describes the Qualcomm IPA.  The IPA is capable of offloading
certain network processing tasks (e.g. filtering, routing, and NAT) from
the main processor.  The IPA currently serves only as a network interface,
providing access to an LTE network available via a modem.

See also:
  bindings/interrupt-controller/interrupts.txt
  bindings/interconnect/interconnect.txt
  bindings/soc/qcom/qcom,smp2p.txt
  bindings/reserved-memory/reserved-memory.txt

- compatible:
	Usage: required
	Value type: <stringlist>
	Definition: Must be one of:
			"qcom,ipa-sdm845-modem_init"
			"qcom,ipa-sdm845-tz_init"

-reg:
	Usage: required
	Value type: <prop-encoded-array>
	Definition: Specifies the physical address spaces of the IPA and GSI.

-reg-names:
	Usage: required
	Value type: <stringlist>
	Definition: The names of the address space ranges defined by the "reg"
		    property.  Must be "ipa" and "gsi".

- interrupts-extended:
	Usage: required
	Value type: <prop-encoded-array>
	Definition: Specifies the IRQs used by the IPA.  Four cells are
		    required, specifying: the IPA IRQ; the GSI IRQ; the
		    clock query interrupt from the modem; and the "ready
		    for stage 2 initialization" interrupt from the modem.
		    The first two are hardware IRQs; the third and fourth
		    are SMP2P input interrupts.

- interrupt-names:
	Usage: required
	Value type: <stringlist>
	Definition: The names of the interrupts defined by the
		    "interrupts-extended" property.  Must be "ipa", "gsi",
		    "ipa-clock-query", and "ipa-post-init".

- interconnects:
	Usage: required
	Value type: <prop-encoded-array>
	Definition: Specifies the interconnects used by the IPA.  Three
		    cells are required, specifying: the path from the IPA
		    to memory, from IPA to internal (SoC resident) memory,
		    and between the AP subsystem and IPA for register access.

- interconnect-names:
	Value type: <stringlist>
	Definition: The names of the interconnects defined by the
		    "interconnects" property.  Must be "memory", "imem",
		    and "config".

- qcom,smem-states
	Usage: required
	Value type: <prop-encoded-array>
	Definition: The state bits used for SMP2P output.  Two cells must
		    be specified.  The first indicates whether the value
		    in the second bit is valid (1 means valid).  The second,
		    if valid, defines whether the IPA clock is enabled
		    (1 means enabled).

- qcom,smem-state-names
	Usage: required
	Value type: <stringlist>
	Definition: The names of the state bits used for SMP2P output.
		    These must be "ipa-clock-enabled-valid" and
		    "ipa-clock-enabled".

- memory-region
	Usage: required for "qcom,ipa-sdm845-tz_init".
	Value type: <prop-encoded-array>
	Definition: A phandle for a reserved memory area that holds the
		    firmware passed to Trust Zone for authentication.

= EXAMPLE

The following example represents the IPA present in the SDM845 SoC.  It
shows portions of the "modem-smp2p" node to indicate its relationship
with the interrupts and SMEM states used by the IPA.

	modem-smp2p {
		compatible = "qcom,smp2p";
		. . .
		ipa_smp2p_out: ipa-ap-to-modem {
			qcom,entry-name = "ipa";
			#qcom,smem-state-cells = <1>;
		};

		ipa_smp2p_in: ipa-modem-to-ap {
			qcom,entry-name = "ipa";
			interrupt-controller;
			#interrupt-cells = <2>;
		};
	};

	ipa@1e00000 {
		compatible = "qcom,ipa-sdm845-modem_init";

		reg = <0x1e40000 0x34000>,
		      <0x1e04000 0x2c000>;
		reg-names = "ipa",
			    "gsi";

		interrupts-extended = <&intc 0 311 IRQ_TYPE_LEVEL_HIGH>,
				      <&intc 0 432 IRQ_TYPE_LEVEL_HIGH>,
				      <&ipa_smp2p_in 0 IRQ_TYPE_EDGE_RISING>,
				      <&ipa_smp2p_in 1 IRQ_TYPE_EDGE_RISING>;
		interrupt-names = "ipa",
				  "gsi",
				  "ipa-clock-query",
				  "ipa-post-init";

		interconnects = <&qnoc MASTER_IPA &qnoc SLAVE_EBI1>,
			        <&qnoc MASTER_IPA &qnoc SLAVE_IMEM>,
			        <&qnoc MASTER_APPSS_PROC &qnoc SLAVE_IPA_CFG>;
		interconnect-names = "memory",
				     "imem",
				     "config";

		qcom,smem-states = <&ipa_smp2p_out 0>,
				   <&ipa_smp2p_out 1>;
		qcom,smem-state-names = "ipa-clock-enabled-valid",
					"ipa-clock-enabled";
	};
```

## Documentation/devicetree/bindings/soc/qcom/qcom,rmnet-ipa.txt
```
Qualcomm IPA RMNet Driver

This binding describes the IPA RMNet driver, which is used to
represent virtual interfaces available on the modem accessed via
the IPA.  Other than the compatible string there are no properties
associated with this device.

- compatible:
	Must be "qcom,rmnet-ipa".

= EXAMPLE

	qcom,rmnet-ipa {
		compatible = "qcom,rmnet-ipa";
	};
```

## Documentation/devicetree/bindings/soundwire/bus.txt
```
Soundwire bus

SoundWire is a 2-pin multi-drop interface with data and clock line.
It facilitates development of low cost, efficient, high performance systems.

Required property for Soundwire controller node:

Required properties:
- #address-cells	- Should be 1
- #size-cell		- Should be 0 
Rest of the controller bindings are very much specific to vendor.

Child nodes:
Every Soundwire controller node can contain zero or more child nodes
representing slave devices on the bus. Every Soundwire slave device is
uniquely determined by the enumeration address containing 5 fields:
Soundwire Version, Instance ID, Manufacturer ID, Part ID and Class ID
for a device.

Required property for SLIMbus child node if it is present:
- reg		- Should be ('Instance ID') from Soundwire
		  Enumeration  Address.
		  Instance ID Is for the cases where multiple Devices of the
		  same type or Class are attached to the bus.

- compatible	-"swrVER,MFD,PID,CID". The textual representation of
		  Soundwire Version, Manufacturer ID, Part ID, shall be
		  in lower case hexadecimal with leading zeroes suppressed
		  Version number '0x10' represents SoundWire 1.0
		  Version number '0x11' represents SoundWire 1.1
		

Soundwire example for Qualcomm's soundwire controller:

	soundwire@c2d0000 {
		compatible = "qcom,soundwire-v1.5.0"
		reg = <0x0c2d0000 0x2000>;
		...
		#address-cells = <1>;
		#size-cell = <0>;

		wsa8810@0{
			compatible = "swr10,217,211,0";
			reg = <0>;
		};

		wsa8810@1{
			compatible = "swr10,217,211,0";
			reg = <1>;
		};
	};
```

## drivers/interconnect/qcom/Kconfig
```kconfig
config INTERCONNECT_QCOM
	bool "Qualcomm Network-on-Chip interconnect drivers"
	depends on INTERCONNECT
	depends on ARCH_QCOM || COMPILE_TEST

config INTERCONNECT_QCOM_SMD_RPM
	tristate "Qualcomm SMD RPM interconnect driver"
	depends on INTERCONNECT_QCOM
	help
	  This is a driver for communicating interconnect related configuration
	  details with a remote processor (RPM) on Qualcomm platforms.
```

## Documentation/devicetree/bindings/display/bridge/ti,sn65dsi86.txt
```
SN65DSI86 DSItoeDP bridge chip
------------------------------

This is the binding for Texas Instruments SN65DSI86 bridge.

Required properties:

- compatible: Must be "ti,sn65dsi86"
- reg:					Main I2C slave ID (for I2C host driver)
- sn,irq-gpio:				Main IRQ gpio mapping
- sn,enable-gpio			Main reset gpio mapping

Required nodes:

This device has two video ports. Their connections are modelled using the OF
graph bindings specified in Documentation/devicetree/bindings/graph.txt.

- Video port 0 for DSI input
- Video port 1 for eDP output

Example
-------

vga-bridge {
	compatible = "ti,sn65dsi86";
	#address-cells = <1>;
	#size-cells = <0>;
	reg = <0x39>;

	sn,irq-gpio = <&msmgpio 32 0>;
	sn,enable-gpio = <&msmgpio 33 0>;

	ports {
		#address-cells = <1>;
		#size-cells = <0>;

		port@0 {
			reg = <0>;

			vga_bridge_in: endpoint {
				remote-endpoint = <&dsi_out>;
			};
		};

		port@1 {
			reg = <1>;

			vga_bridge_out: endpoint {
				remote-endpoint = <&edp_in>;
			};
		};
	};
}
```

## Documentation/devicetree/bindings/display/msm/dpu.txt
```
Qualcomm Technologies, Inc. DPU KMS

Snapdragon Display Engine implements Linux DRM/KMS APIs to drive user
interface to different panel interfaces. DPU driver is the core of
display subsystem which manage all data paths to different panel interfaces.

Required properties
- compatible: Must be "qcom,dpu-kms"
- compatible: "msm-hdmi-audio-codec-rx";
- reg: Offset and length of the register set for the device.
- reg-names : Names to refer to register sets related to this device
- clocks: List of Phandles for clock device nodes
    needed by the device.
- clock-names: List of clock names needed by the device.
- mmagic-supply: Phandle for mmagic mdss supply regulator device node.
- vdd-supply: Phandle for vdd regulator device node.
- interrupt-parent: Must be core interrupt controller.
- interrupts: Interrupt associated with MDSS.
- interrupt-controller: Mark the device node as an interrupt controller.
- #interrupt-cells: Should be one. The first cell is interrupt number.
- iommus: Specifies the SID's used by this context bank.

Optional properties:
- clock-rate:		List of clock rates in Hz.
- clock-max-rate:	List of maximum clock rate in Hz that this device supports.
- qcom,platform-supply-entries:	A node that lists the elements of the supply. There
				can be more than one instance of this binding,
				in which case the entry would be appended with
				the supply entry index.
				e.g. qcom,platform-supply-entry@0
				-- reg: offset and length of the register set for the device.
				-- qcom,supply-name: name of the supply (vdd/vdda/vddio)
				-- qcom,supply-min-voltage: minimum voltage level (uV)
				-- qcom,supply-max-voltage: maximum voltage level (uV)
				-- qcom,supply-enable-load: load drawn (uA) from enabled supply
				-- qcom,supply-disable-load: load drawn (uA) from disabled supply
				-- qcom,supply-pre-on-sleep: time to sleep (ms) before turning on
				-- qcom,supply-post-on-sleep: time to sleep (ms) after turning on
				-- qcom,supply-pre-off-sleep: time to sleep (ms) before turning off
				-- qcom,supply-post-off-sleep: time to sleep (ms) after turning off
- qcom,dpu-dram-channels:	This represents the number of channels in the
				Bus memory controller.
- qcom,dpu-num-nrt-paths:	Integer property represents the number of non-realtime
				paths in each Bus Scaling Usecase. This value depends on
				number of AXI ports that are dedicated to non-realtime VBIF
				for particular chipset.
				These paths must be defined after rt-paths in
				"qcom,msm-bus,vectors-KBps" vector request.

Bus Scaling Subnodes:
- qcom,dpu-reg-bus:		Property to provide Bus scaling for register access for
				mdss blocks.
- qcom,dpu-data-bus:		Property to provide Bus scaling for data bus access for
				mdss blocks.
- qcom,dpu-llcc-bus:		Property to provide Bus scaling for data bus access for
				mnoc to llcc.
- qcom,dpu-ebi-bus:		Property to provide Bus scaling for data bus access for
				llcc to ebi.

- qcom,dpu-inline-rotator:	A 2 cell property, with format of (rotator phandle,
				instance id), of inline rotator device.

Bus Scaling Data:
- qcom,msm-bus,name:		String property describing client name.
- qcom,msm-bus,num-cases:	This is the number of Bus Scaling use cases
				defined in the vectors property.
- qcom,msm-bus,num-paths:	This represents the number of paths in each
				Bus Scaling Usecase.
- qcom,msm-bus,vectors-KBps:	* A series of 4 cell properties, with a format
				of (src, dst, ab, ib) which is defined at
				Documentation/devicetree/bindings/arm/msm/msm_bus.txt
				* Current values of src & dst are defined at
				include/linux/msm-bus-board.h

SMMU Subnodes:
- smmu_dpu_****:		Child nodes representing dpu smmu virtual
				devices

Subnode properties:
- compatible:			Compatible names used for smmu devices.
				names should be:
				"qcom,smmu_dpu_unsec": smmu context bank device
				for unsecure dpu real time domain.
				"qcom,smmu_dpu_sec": smmu context bank device
				for secure dpu real time domain.
				"qcom,smmu_dpu_nrt_unsec": smmu context bank device
				for unsecure dpu non-real time domain.
				"qcom,smmu_dpu_nrt_sec": smmu context bank device
				for secure dpu non-real time domain.


Please refer to ../../interrupt-controller/interrupts.txt for a general
description of interrupt bindings.

Example:
  mdss_mdp: qcom,mdss_mdp@900000 {
    compatible = "qcom,dpu-kms";
    reg = <0x00900000 0x90000>,
          <0x009b0000 0x1040>,
          <0x009b8000 0x1040>,
          <0x0aeac000 0x00f0>;
    reg-names = "mdp_phys",
      "vbif_phys",
      "vbif_nrt_phys",
      "regdma_phys";
    clocks = <&clock_mmss clk_mdss_ahb_clk>,
      <&clock_mmss clk_mdss_axi_clk>,
      <&clock_mmss clk_mdp_clk_src>,
      <&clock_mmss clk_mdss_mdp_vote_clk>,
      <&clock_mmss clk_smmu_mdp_axi_clk>,
      <&clock_mmss clk_mmagic_mdss_axi_clk>,
      <&clock_mmss clk_mdss_vsync_clk>;
    clock-names = "iface_clk",
      "bus_clk",
      "core_clk_src",
      "core_clk",
      "iommu_clk",
      "mmagic_clk",
      "vsync_clk";
    clock-rate = <0>, <0>, <0>;
    clock-max-rate= <0 320000000 0>;
    mmagic-supply = <&gdsc_mmagic_mdss>;
    vdd-supply = <&gdsc_mdss>;
    interrupt-parent = <&intc>;
    interrupts = <0 83 0>;
    interrupt-controller;
    #interrupt-cells = <1>;
    iommus = <&mdp_smmu 0>;

    qcom,dpu-dram-channels = <2>;
    qcom,dpu-num-nrt-paths = <1>;

    qcom,msm-hdmi-audio-rx {
        compatible = "qcom,msm-hdmi-audio-codec-rx";
    };

    qcom,platform-supply-entries {
       #address-cells = <1>;
       #size-cells = <0>;
       qcom,platform-supply-entry@0 {
           reg = <0>;
           qcom,supply-name = "vdd";
           qcom,supply-min-voltage = <0>;
           qcom,supply-max-voltage = <0>;
           qcom,supply-enable-load = <0>;
           qcom,supply-disable-load = <0>;
           qcom,supply-pre-on-sleep = <0>;
           qcom,supply-post-on-sleep = <0>;
           qcom,supply-pre-off-sleep = <0>;
           qcom,supply-post-off-sleep = <0>;
        };
    };

    qcom,dpu-data-bus {
        qcom,msm-bus,name = "mdss_dpu";
        qcom,msm-bus,num-cases = <3>;
        qcom,msm-bus,num-paths = <3>;
        qcom,msm-bus,vectors-KBps =
            <22 512 0 0>, <23 512 0 0>, <25 512 0 0>,
            <22 512 0 6400000>, <23 512 0 6400000>,
                <25 512 0 6400000>,
            <22 512 0 6400000>, <23 512 0 6400000>,
                <25 512 0 6400000>;
    };
    qcom,dpu-llcc-bus {
        qcom,msm-bus,name = "mdss_dpu_llcc";
        qcom,msm-bus,num-cases = <3>;
        qcom,msm-bus,num-paths = <1>;
        qcom,msm-bus,vectors-KBps =
            <132 770 0 0>,
            <132 770 0 6400000>,
            <132 770 0 6400000>;
    };
    qcom,dpu-ebi-bus {
        qcom,msm-bus,name = "mdss_dpu_ebi";
        qcom,msm-bus,num-cases = <3>;
        qcom,msm-bus,num-paths = <1>;
        qcom,msm-bus,vectors-KBps =
            <129 512 0 0>,
            <129 512 0 6400000>,
            <129 512 0 6400000>;
    };

    qcom,dpu-reg-bus {
        /* Reg Bus Scale Settings */
        qcom,msm-bus,name = "mdss_reg";
        qcom,msm-bus,num-cases = <4>;
        qcom,msm-bus,num-paths = <1>;
        qcom,msm-bus,active-only;
        qcom,msm-bus,vectors-KBps =
              <1 590 0 0>,
              <1 590 0 76800>,
              <1 590 0 160000>,
              <1 590 0 320000>;
        };

    smmu_kms_unsec: qcom,smmu_kms_unsec_cb {
        compatible = "qcom,smmu_dpu_unsec";
        iommus = <&mmss_smmu 0>;
    };

    smmu_kms_sec: qcom,smmu_kms_sec_cb {
        compatible = "qcom,smmu_dpu_sec";
        iommus = <&mmss_smmu 1>;
    };
  };
```

## Documentation/devicetree/bindings/drm/msm/dpu-wb.txt
```
QTI Snapdragon Display Engine (DPU) writeback display

Required properties:
- compatible:		"qcom,wb-display"

Optional properties:
- cell-index:		Index of writeback device instance.
			Default to 0 if not specified.
- label:		String to describe this writeback display.
			Default to "unknown" if not specified.

Example:

/ {
	...

	dpu_wb: qcom,wb-display {
		compatible = "qcom,wb-display";
		cell-index = <2>;
		label = "wb_display";
	};

};
```

## Documentation/devicetree/bindings/interconnect/interconnect.txt
```
Interconnect Provider Device Tree Bindings
=========================================

The purpose of this document is to define a common set of generic interconnect
providers/consumers properties.


= interconnect providers =

The interconnect provider binding is intended to represent the interconnect
controllers in the system. Each provider registers a set of interconnect
nodes, which expose the interconnect related capabilities of the interconnect
to consumer drivers. These capabilities can be throughput, latency, priority
etc. The consumer drivers set constraints on interconnect path (or endpoints)
depending on the use case. Interconnect providers can also be interconnect
consumers, such as in the case where two network-on-chip fabrics interface
directly

Required properties:
- compatible : contains the interconnect provider compatible string
- #interconnect-cells : number of cells in a interconnect specifier needed to
			encode the interconnect node id

Example:

		snoc: snoc@580000 {
			compatible = "qcom,msm8916-snoc";
			#interconnect-cells = <1>;
			reg = <0x580000 0x14000>;
			clock-names = "bus_clk", "bus_a_clk";
			clocks = <&rpmcc RPM_SMD_SNOC_CLK>,
				 <&rpmcc RPM_SMD_SNOC_A_CLK>;
		};
```

## Documentation/devicetree/bindings/mmc/sdhci-msm.txt
```
* Qualcomm SDHCI controller (sdhci-msm)

This file documents differences between the core properties in mmc.txt
and the properties used by the sdhci-msm driver.

Required properties:
- compatible: Should contain "qcom,sdhci-msm-v4" or "qcom,sdhci-msm-v5".
		 For SDCC version 5.0.0, MCI registers are removed from SDCC
		 interface and some registers are moved to HC. New compatible
		 string is added to support this change - "qcom,sdhci-msm-v5".
- reg: Base address and length of the register in the following order:
	- Host controller register map (required)
	- SD Core register map (required)
- interrupts: Should contain an interrupt-specifiers for the interrupts:
	- Host controller interrupt (required)
- pinctrl-names: Should contain only one value - "default".
- pinctrl-0: Should specify pin control groups used for this controller.
- clocks: A list of phandle + clock-specifier pairs for the clocks listed in clock-names.
- clock-names: Should contain the following:
	"iface" - Main peripheral bus clock (PCLK/HCLK - AHB Bus clock) (required)
	"core"	- SDC MMC clock (MCLK) (required)
	"bus"	- SDCC bus voter clock (optional)
	"xo"	- TCXO clock (optional)
	"cal"	- reference clock for RCLK delay calibration (optional)
	"sleep"	- sleep clock for RCLK delay calibration (optional)
- <supply-name>-supply: phandle to the regulator device tree node if voltage
		regulators needs to be handled from within sdhci-msm layer.
		Supported "supply-name" are "vdd" and "vdd-io".

Optional Properties:
	- qcom,<supply>-always-on - specifies whether supply should be kept
		"on" always.
	- qcom,<supply>-lpm_sup - specifies whether supply can be kept in low
		power mode (lpm).
	- qcom,<supply>-voltage_level - specifies voltage levels for supply.
		Should be specified in pairs (min, max), units uV.
	- qcom,<supply>-current_level - specifies load levels for supply in lpm
		or high power mode (hpm). Should be specified in
		pairs (lpm, hpm), units uA.



Example:

	sdhc_1: sdhci@f9824900 {
		compatible = "qcom,sdhci-msm-v4";
		reg = <0xf9824900 0x11c>, <0xf9824000 0x800>;
		interrupts = <0 123 0>;
		bus-width = <8>;
		non-removable;

		vdd-supply = <&pm8941_l20>;
		qcom,vdd-voltage-level = <2950000 2950000>;
		qcom,vdd-current-level = <9000 800000>;

		vdd-io-supply = <&pm8941_s3>;
		qcom,vdd-io-always-on;
		qcom,vdd-io-lpm-sup;
		qcom,vdd-io-voltage-level = <1800000 2950000>;
		qcom,vdd-io-current-level = <6 22000>;

		pinctrl-names = "default";
		pinctrl-0 = <&sdc1_clk &sdc1_cmd &sdc1_data>;

		clocks = <&gcc GCC_SDCC1_APPS_CLK>, <&gcc GCC_SDCC1_AHB_CLK>;
		clock-names = "core", "iface";
	};

	sdhc_2: sdhci@f98a4900 {
		compatible = "qcom,sdhci-msm-v4";
		reg = <0xf98a4900 0x11c>, <0xf98a4000 0x800>;
		interrupts = <0 125 0>;
		bus-width = <4>;
		cd-gpios = <&msmgpio 62 0x1>;

		vmmc-supply = <&pm8941_l21>;
		vqmmc-supply = <&pm8941_l13>;

		pinctrl-names = "default";
		pinctrl-0 = <&sdc2_clk &sdc2_cmd &sdc2_data>;

		clocks = <&gcc GCC_SDCC2_APPS_CLK>, <&gcc GCC_SDCC2_AHB_CLK>;
		clock-names = "core", "iface";
	};
```

## Documentation/devicetree/bindings/net/qualcomm-bluetooth.txt
```
Qualcomm Bluetooth Chips
---------------------

This documents the binding structure and common properties for serial
attached Qualcomm devices.

Serial attached Qualcomm devices shall be a child node of the host UART
device the slave device is attached to.

Required properties:
 - compatible: should contain one of the following:
   * "qcom,qca6174-bt"
   * "qcom,wcn3990-bt"

Optional properties:
 - enable-gpios: gpio specifier used to enable chip
 - clocks: clock provided to the controller (SUSCLK_32KHZ)
 - vddpa-supply: Bluetooth VDD PA regulator handle
 - vddio-supply: Bluetooth VDD IO regulator handle
 - vddldo-supply: Bluetooth VDD LDO regulator handle. Kept under optional
		  parameters as some of the chipsets doesn't require ldo or
		  it may use from same vddio.
 - vddxtal-supply: Bluetooth VDD XTAL regulator handle
 - vddcore-supply: Bluetooth VDD CORE regulator handle
 - vddpwd-supply: Chip power down gpio is required when bluetooth module
		  and other modules like wifi co-exist in a singe chip and
		  shares a common gpio to bring chip out of reset.
 - max-speed: operating speed of the chip.

Examples:

serial@7570000 {
	label = "BT-UART";
	status = "okay";

	bluetooth {
		compatible = "qcom,qca6174-bt";

		enable-gpios = <&pm8994_gpios 19 GPIO_ACTIVE_HIGH>;
		clocks = <&divclk4>;
	};
};

serial@898000 {
	label = "BT-UART";
	status = "okay";

	bluetooth: bt_wcn3990 {
		compatible = "qcom,wcn3990-bt";
		vddio-supply = <&pm8998_s3>;
		vddxtal-supply = <&pm8998_s5>;
		vddcore-supply = <&pm8998_l7>;
		vddpa-supply = <&pm8998_l17>;
		vddldo-supply = <&pm8998_l25>;
		max-speed = <3200000>;
	};
};
```
